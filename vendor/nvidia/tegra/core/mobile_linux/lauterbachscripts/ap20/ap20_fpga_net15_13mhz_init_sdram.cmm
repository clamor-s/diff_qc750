; Lauterbach TRACE32 debugger script to boot CPU on AP20 NVAP BSP from SDRAM.
; *************** Will work only with FPGA SYSTEMS ***************

; For NVIDIA internal use only. Customers should not use this script
; unless NVIDIA explicitly directs them to do so.


; Set supervisor mode
R.S CPSR 0x000000D3

; Blast any left over Boot Information Table (BIT) in IRAM so that the
; bootloader can properly re-initialize the chip.
d.s sd:0x40000000 %LE %LONG -1 -1 -1 -1 -1 -1 -1 -1 -1 -1 -1 -1 -1 -1 -1 -1

; Initialize the memory controller and clock controller


D.S SD:0x600060DC  %LE %LONG  0x40000000 ;// PLLD_MISC

D.S SD:0x600060B0  %LE %LONG  0x80003119 ;// PLLA_BASE
D.S SD:0x60006080  %LE %LONG  0x8002580D ;// PLLC_BASE
D.S SD:0x600060D0  %LE %LONG  0x8002520D ;// PLLD_BASE
D.S SD:0x60006090  %LE %LONG  0x80026C0D ;// PLLM_BASE
D.S SD:0x600060A0  %LE %LONG  0x80000000 ;// PLLP_BASE
D.S SD:0x600060C0  %LE %LONG  0x8003C00D ;// PLLU_BASE
D.S SD:0x600060E0  %LE %LONG  0x8003840D ;// PLLX_BASE

wait 50.ms

D.S SD:0x600060B0  %LE %LONG  0xC0003119 ;// PLLA_BASE
D.S SD:0x60006080  %LE %LONG  0xC002580D ;// PLLC_BASE
D.S SD:0x600060D0  %LE %LONG  0xC002520D ;// PLLD_BASE
D.S SD:0x60006090  %LE %LONG  0xC0026C0D ;// PLLM_BASE
D.S SD:0x600060A0  %LE %LONG  0xC0000000 ;// PLLP_BASE
D.S SD:0x600060C0  %LE %LONG  0xC003C00D ;// PLLU_BASE
D.S SD:0x600060E0  %LE %LONG  0xC003840D ;// PLLX_BASE

wait 50.ms

D.S SD:0x600060B0  %LE %LONG  0x40003119 ;// PLLA_BASE
D.S SD:0x600060D0  %LE %LONG  0x4002520D ;// PLLD_BASE
D.S SD:0x60006080  %LE %LONG  0x4002580D ;// PLLC_BASE
D.S SD:0x60006090  %LE %LONG  0x40026C0D ;// PLLM_BASE
D.S SD:0x600060A0  %LE %LONG  0x40000000 ;// PLLP_BASE
D.S SD:0x600060C0  %LE %LONG  0x4003C00D ;// PLLU_BASE
D.S SD:0x600060E0  %LE %LONG  0x4003840D ;// PLLX_BASE

wait 50.ms

D.S SD:0x60006084  %LE %LONG  0x00000003 ;// PLLC_OUT
D.S SD:0x60006094  %LE %LONG  0x00000203 ;// PLLM_OUT

wait 50.ms

D.S SD:0x60006010  %LE %LONG  0xBFFFFFF9 ;// CLK_RST_CONTROLLER_CLK_OUT_ENB_L_0
D.S SD:0x60006014  %LE %LONG  0xFEFFFEF7 ;// CLK_RST_CONTROLLER_CLK_OUT_ENB_H_0
D.S SD:0x60006018  %LE %LONG  0x07F00B00 ;// CLK_RST_CONTROLLER_CLK_OUT_ENB_U_0

D.S SD:0x60006020  %LE %LONG  0x20008888 ;// CLK_RST_CONTROLLER_CCLK_BURST_POLICY_0
D.S SD:0x60006024  %LE %LONG  0x80000000 ;// CLK_RST_CONTROLLER_SUPER_CCLK_DIVIDER_0
D.S SD:0x60006028  %LE %LONG  0x20001111 ;// CLK_RST_CONTROLLER_SCLK_BURST_POLICY_0
D.S SD:0x6000602C  %LE %LONG  0x80000000 ;// CLK_RST_CONTROLLER_SUPER_SCLK_DIVIDER_0
D.S SD:0x60006030  %LE %LONG  0x00000010 ;// CLK_RST_CONTROLLER_CLK_SYSTEM_RATE_0

D.S SD:0x6000619C  %LE %LONG  0x03000000 ;// CLK_RST_CONTROLLER_CLK_SOURCE_EMC_0
D.S SD:0x6000614C  %LE %LONG  0x40000002 ;// CLK_RST_CONTROLLER_CLK_SOURCE_MEM_0
D.S SD:0x60006160  %LE %LONG  0x00000006 ;// CLK_RST_CONTROLLER_CLK_SOURCE_NDFLASH_0
D.S SD:0x600061D0  %LE %LONG  0x0000000A ;// CLK_RST_CONTROLLER_CLK_SOURCE_NOR_0

D.S SD:0x60006004  %LE %LONG  0x40000001 ;// CLK_RST_CONTROLLER_RST_DEVICES_L_0
D.S SD:0x60006008  %LE %LONG  0x01000108 ;// CLK_RST_CONTROLLER_RST_DEVICES_H_0
D.S SD:0x6000600C  %LE %LONG  0xFFFFF4FF ;// CLK_RST_CONTROLLER_RST_DEVICES_U_0
D.S SD:0x60006044  %LE %LONG  0x00010000 ;// CLK_RST_CONTROLLER_CLK_MASK_ARM_0

;// InitEMC DDR 13Mhz
D.S SD:0x7000F40C  %LE %LONG  0x0300FF00 ;// EMC_CFG_0
D.S SD:0x7000F408  %LE %LONG  0x01000410 ;// EMC_DBG_0
D.S SD:0x7000F504  %LE %LONG  0x00000001 ;// EMC_FBIO_CFG5_0
D.S SD:0x7000F42C  %LE %LONG  0x00000001 ;// EMC_RC_0
D.S SD:0x7000F430  %LE %LONG  0x00000002 ;// EMC_RFC_0
D.S SD:0x7000F434  %LE %LONG  0x00000001 ;// EMC_RAS_0
D.S SD:0x7000F438  %LE %LONG  0x00000001 ;// EMC_RP_0
D.S SD:0x7000F43C  %LE %LONG  0x00000004 ;// EMC_R2W_0
D.S SD:0x7000F440  %LE %LONG  0x00000003 ;// EMC_W2R_0
D.S SD:0x7000F444  %LE %LONG  0x00000001 ;// EMC_R2P_0
D.S SD:0x7000F448  %LE %LONG  0x00000003 ;// EMC_W2P_0
D.S SD:0x7000F44C  %LE %LONG  0x00000001 ;// EMC_RD_RCD_0
D.S SD:0x7000F450  %LE %LONG  0x00000001 ;// EMC_WR_RCD_0
D.S SD:0x7000F454  %LE %LONG  0x00000001 ;// EMC_RRD_0
D.S SD:0x7000F458  %LE %LONG  0x00000001 ;// EMC_REXT_0
D.S SD:0x7000F45C  %LE %LONG  0x00000000 ;// EMC_WDV_0
D.S SD:0x7000F460  %LE %LONG  0x00000001 ;// EMC_QUSE_0
D.S SD:0x7000F464  %LE %LONG  0x00000000 ;// EMC_QRST_0
D.S SD:0x7000F468  %LE %LONG  0x00000007 ;// EMC_QSAFE_0
D.S SD:0x7000F46C  %LE %LONG  0x00000007 ;// EMC_RDV_0
D.S SD:0x7000F470  %LE %LONG  0x0000003F ;// EMC_REFRESH_0
D.S SD:0x7000F474  %LE %LONG  0x00000000 ;// EMC_BURST_REFRESH_NUM_0
D.S SD:0x7000F478  %LE %LONG  0x00000002 ;// EMC_PDEX2WR_0
D.S SD:0x7000F47C  %LE %LONG  0x00000002 ;// EMC_PDEX2RD_0
D.S SD:0x7000F480  %LE %LONG  0x00000001 ;// EMC_PCHG2PDEN_0
D.S SD:0x7000F484  %LE %LONG  0x00000001 ;// EMC_ACT2PDEN_0
D.S SD:0x7000F488  %LE %LONG  0x00000002 ;// EMC_AR2PDEN_0
D.S SD:0x7000F490  %LE %LONG  0x00000003 ;// EMC_TXSR_0
D.S SD:0x7000F494  %LE %LONG  0x00000002 ;// EMC_TCKE_0
D.S SD:0x7000F498  %LE %LONG  0x00000000 ;// EMC_TFAW_0
D.S SD:0x7000F49C  %LE %LONG  0x00000000 ;// EMC_TRPAB_0
D.S SD:0x7000F4A0  %LE %LONG  0x00000000 ;// EMC_TCLKSTABLE_0
D.S SD:0x7000F4A4  %LE %LONG  0x00000002 ;// EMC_TCLKSTOP_0
D.S SD:0x7000F4A8  %LE %LONG  0x00000000 ;// EMC_TREFBW_0
D.S SD:0x7000F48C  %LE %LONG  0x00000004 ;// EMC_RW2PDEN_0
D.S SD:0x7000F4F8  %LE %LONG  0x2F2F2F2F ;// EMC_FBIO_DQSIB_DLY_0
D.S SD:0x7000F4FC  %LE %LONG  0x00000000 ;// EMC_FBIO_DQSIB_DLY_MSB_0
D.S SD:0x7000F50C  %LE %LONG  0x2F2F2F2F ;// EMC_FBIO_QUSE_DLY_0
D.S SD:0x7000F510  %LE %LONG  0x00000000 ;// EMC_FBIO_QUSE_DLY_MSB_0
D.S SD:0x7000F514  %LE %LONG  0x00000000 ;// EMC_FBIO_CFG6_0
D.S SD:0x7000F428  %LE %LONG  0x00000001 ;// EMC_TIMING_CONTROL_0
D.S SD:0x7000F424  %LE %LONG  0x00000001 ;// EMC_PIN_0
D.S SD:0x7000F4DC  %LE %LONG  0x00000001 ;// EMC_NOP_0
D.S SD:0x7000F4D8  %LE %LONG  0x00000001 ;// EMC_PRE_0
D.S SD:0x7000F4D0  %LE %LONG  0x00100001 ;// EMC_EMRS_0
D.S SD:0x7000F4CC  %LE %LONG  0x0000002A ;// EMC_MRS_0
D.S SD:0x7000F4D8  %LE %LONG  0x00000001 ;// EMC_PRE_0
D.S SD:0x7000F4D4  %LE %LONG  0x00000001 ;// EMC_REF_0
D.S SD:0x7000F4D4  %LE %LONG  0x00000001 ;// EMC_REF_0
D.S SD:0x7000F420  %LE %LONG  0x80000000 ;// EMC_REFCTRL_0
D.S SD:0x7000F00C  %LE %LONG  0x00080000 ;// MC_EMEM_CFG_0
D.S SD:0x7000F010  %LE %LONG  0x01060204 ;// MC_EMEM_ADR_CFG_0
D.S SD:0x7000F410  %LE %LONG  0x01060204 ;// EMC_ADR_CFG_0
D.S SD:0x7000F414  %LE %LONG  0x00060204 ;// EMC_ADR_CFG_1_0
D.S SD:0x7000F014  %LE %LONG  0x20002030 ;// MC_EMEM_ARB_CFG0_0
D.S SD:0x7000F018  %LE %LONG  0x000007DF ;// MC_EMEM_ARB_CFG1_0
D.S SD:0x7000F01C  %LE %LONG  0x120A120A ;// MC_EMEM_ARB_CFG2_0
D.S SD:0x6000C0E0  %LE %LONG  0x00010000 ;// AHB_ARBITRATION_XBAR_CTRL_0
D.S SD:0x70000024  %LE %LONG  0x000000C0 ;// APB_MISC_PP_CONFIG_CTL_0
D.S SD:0x7000E434  %LE %LONG  0x00000007 ;// APBDEV_PMC_REMOVE_CLAMPING_CMD_0

enddo

