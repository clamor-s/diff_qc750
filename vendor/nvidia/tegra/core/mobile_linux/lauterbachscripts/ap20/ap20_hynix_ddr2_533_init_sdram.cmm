; Lauterbach TRACE32 debugger script to boot CPU on AP20 NVAP BSP from SDRAM.
; *************** Will work only with REAL SILICON ***************

; For NVIDIA internal use only. Customers should not use this script
; unless NVIDIA explicitly directs them to do so.


; Set supervisor mode
R.S CPSR 0x000000D3

; Blast any left over Boot Information Table (BIT) in IRAM so that the
; bootloader can properly re-initialize the chip.
d.s sd:0x40000000 %LE %LONG -1 -1 -1 -1 -1 -1 -1 -1 -1 -1 -1 -1 -1 -1 -1 -1

; Initialize the memory controller and clock controller


D.S SD:0x600060DC  %LE %LONG  0x40000800 ;// PLLD_MISC

D.S SD:0x60006080  %LE %LONG  0x8002580C ;// PLLC_BASE
D.S SD:0x60006090  %LE %LONG  0x8012580C ;// PLLM_BASE
D.S SD:0x600060A0  %LE %LONG  0x8013600C ;// PLLP_BASE
D.S SD:0x600060C0  %LE %LONG  0x8003C00C ;// PLLU_BASE
D.S SD:0x600060E0  %LE %LONG  0x8002580C ;// PLLX_BASE

wait 50.ms

D.S SD:0x60006080  %LE %LONG  0xC002580C ;// PLLC_BASE
D.S SD:0x60006090  %LE %LONG  0xC012580C ;// PLLM_BASE
D.S SD:0x600060A0  %LE %LONG  0xC013600C ;// PLLP_BASE
D.S SD:0x600060C0  %LE %LONG  0xC003C00C ;// PLLU_BASE
D.S SD:0x600060E0  %LE %LONG  0xC002580C ;// PLLX_BASE

wait 50.ms

D.S SD:0x60006080  %LE %LONG  0x4002580C ;// PLLC_BASE
D.S SD:0x60006090  %LE %LONG  0x4012580C ;// PLLM_BASE
D.S SD:0x600060A0  %LE %LONG  0x4013600C ;// PLLP_BASE
D.S SD:0x600060C0  %LE %LONG  0x4003C00C ;// PLLU_BASE
D.S SD:0x600060E0  %LE %LONG  0x4002580C ;// PLLX_BASE

wait 50.ms

D.S SD:0x60006084  %LE %LONG  0x00000603 ;// PLLC_OUT
D.S SD:0x60006094  %LE %LONG  0x00000203 ;// PLLM_OUT

wait 50.ms

D.S SD:0x60006010  %LE %LONG  0xBFFFFFF9 ;// CLK_RST_CONTROLLER_CLK_OUT_ENB_L_0*
D.S SD:0x60006014  %LE %LONG  0xFEFFFEF7 ;// CLK_RST_CONTROLLER_CLK_OUT_ENB_H_0*
D.S SD:0x60006018  %LE %LONG  0x07F00B00 ;// CLK_RST_CONTROLLER_CLK_OUT_ENB_U_0*

D.S SD:0x60006020  %LE %LONG  0x20008888 ;// CLK_RST_CONTROLLER_CCLK_BURST_POLICY_0
D.S SD:0x60006024  %LE %LONG  0x80000000 ;// CLK_RST_CONTROLLER_SUPER_CCLK_DIVIDER_0
D.S SD:0x60006028  %LE %LONG  0x20001111 ;// CLK_RST_CONTROLLER_SCLK_BURST_POLICY_0
D.S SD:0x6000602C  %LE %LONG  0x80000000 ;// CLK_RST_CONTROLLER_SUPER_SCLK_DIVIDER_0
D.S SD:0x60006030  %LE %LONG  0x00000000 ;// CLK_RST_CONTROLLER_CLK_SYSTEM_RATE_0

D.S SD:0x6000619C  %LE %LONG  0x03000000 ;// CLK_RST_CONTROLLER_CLK_SOURCE_EMC_0
D.S SD:0x60006160  %LE %LONG  0x00000006 ;// CLK_RST_CONTROLLER_CLK_SOURCE_NDFLASH_0
D.S SD:0x600061D0  %LE %LONG  0x0000000A ;// CLK_RST_CONTROLLER_CLK_SOURCE_NOR_0

D.S SD:0x60006004  %LE %LONG  0x40000001 ;// CLK_RST_CONTROLLER_RST_DEVICES_L_0*
D.S SD:0x60006008  %LE %LONG  0x01000108 ;// CLK_RST_CONTROLLER_RST_DEVICES_H_0*
D.S SD:0x6000600C  %LE %LONG  0xFFFFF4FF ;// CLK_RST_CONTROLLER_RST_DEVICES_U_0*
D.S SD:0x60006044  %LE %LONG  0x00000000 ;// CLK_RST_CONTROLLER_CLK_MASK_ARM_0

;// hynix_ddr2_533
D.S SD:0x7000E4E8  %LE %LONG  0x00000001 ;// APBDEV_PMC_DDR_PWR_0
D.S SD:0x700008C4  %LE %LONG  0xFFFFC000 ;// APB_MISC_GP_XM2CFGAPADCTRL_0
D.S SD:0x700008C8  %LE %LONG  0xFFFFFFF0 ;// APB_MISC_GP_XM2CFGCPADCTRL_0
D.S SD:0x700008E4  %LE %LONG  0x08080079 ;// APB_MISC_GP_XM2CFGCPADCTRL2_0
D.S SD:0x700008CC  %LE %LONG  0xFFFFFFF0 ;// APB_MISC_GP_XM2CFGDPADCTRL_0
D.S SD:0x700008E8  %LE %LONG  0x44440009 ;// APB_MISC_GP_XM2CFGDPADCTRL2_0
D.S SD:0x700008D0  %LE %LONG  0xFFFFC000 ;// APB_MISC_GP_XM2CLKCFGPADCTRL_0
D.S SD:0x700008D4  %LE %LONG  0x01F1F008 ;// APB_MISC_GP_XM2COMPPADCTRL_0
D.S SD:0x700008D8  %LE %LONG  0x07076600 ;// APB_MISC_GP_XM2VTTGENPADCTRL_0
D.S SD:0x7000F010  %LE %LONG  0x01060303 ;// MC_EMEM_ADR_CFG_0
D.S SD:0x7000F6D0  %LE %LONG  0x00000000 ;// EMC_CFG_CLKTRIM_0_0
D.S SD:0x7000F6D4  %LE %LONG  0x00000000 ;// EMC_CFG_CLKTRIM_1_0
D.S SD:0x7000F6D8  %LE %LONG  0x00000000 ;// EMC_CFG_CLKTRIM_2_0
D.S SD:0x7000F410  %LE %LONG  0x01060303 ;// EMC_ADR_CFG_0
D.S SD:0x7000F414  %LE %LONG  0x00060303 ;// EMC_ADR_CFG_1_0
D.S SD:0x7000F6DC  %LE %LONG  0x00000802 ;// EMC_CTT_TERM_CTRL_0
D.S SD:0x7000F6A8  %LE %LONG  0x00000000 ;// EMC_AUTO_CAL_INTERVAL_0
D.S SD:0x7000F6A4  %LE %LONG  0x00A60F0F ;// EMC_AUTO_CAL_CONFIG_0
D.S SD:0x7000F6B8  %LE %LONG  0x00000405 ;// EMC_CFG_2_0
D.S SD:0x7000F408  %LE %LONG  0x01000400 ;// EMC_DBG_0
D.S SD:0x7000F504  %LE %LONG  0x00000083 ;// EMC_FBIO_CFG5_0
D.S SD:0x7000F42C  %LE %LONG  0x00000009 ;// EMC_RC_0
D.S SD:0x7000F430  %LE %LONG  0x00000014 ;// EMC_RFC_0
D.S SD:0x7000F434  %LE %LONG  0x00000007 ;// EMC_RAS_0
D.S SD:0x7000F438  %LE %LONG  0x00000002 ;// EMC_RP_0
D.S SD:0x7000F43C  %LE %LONG  0x00000004 ;// EMC_R2W_0
D.S SD:0x7000F440  %LE %LONG  0x00000004 ;// EMC_W2R_0
D.S SD:0x7000F444  %LE %LONG  0x00000002 ;// EMC_R2P_0
D.S SD:0x7000F448  %LE %LONG  0x0000000B ;// EMC_W2P_0
D.S SD:0x7000F44C  %LE %LONG  0x00000002 ;// EMC_RD_RCD_0
D.S SD:0x7000F450  %LE %LONG  0x00000002 ;// EMC_WR_RCD_0
D.S SD:0x7000F454  %LE %LONG  0x00000002 ;// EMC_RRD_0
D.S SD:0x7000F458  %LE %LONG  0x00000001 ;// EMC_REXT_0
D.S SD:0x7000F45C  %LE %LONG  0x00000003 ;// EMC_WDV_0
D.S SD:0x7000F460  %LE %LONG  0x00000004 ;// EMC_QUSE_0
D.S SD:0x7000F464  %LE %LONG  0x00000003 ;// EMC_QRST_0
D.S SD:0x7000F468  %LE %LONG  0x00000007 ;// EMC_QSAFE_0
D.S SD:0x7000F46C  %LE %LONG  0x0000000A ;// EMC_RDV_0
D.S SD:0x7000F470  %LE %LONG  0x0000045F ;// EMC_REFRESH_0
D.S SD:0x7000F474  %LE %LONG  0x00000003 ;// EMC_BURST_REFRESH_NUM_0
D.S SD:0x7000F478  %LE %LONG  0x00000004 ;// EMC_PDEX2WR_0
D.S SD:0x7000F47C  %LE %LONG  0x00000004 ;// EMC_PDEX2RD_0
D.S SD:0x7000F480  %LE %LONG  0x00000002 ;// EMC_PCHG2PDEN_0
D.S SD:0x7000F484  %LE %LONG  0x00000002 ;// EMC_ACT2PDEN_0
D.S SD:0x7000F488  %LE %LONG  0x00000001 ;// EMC_AR2PDEN_0
D.S SD:0x7000F48C  %LE %LONG  0x00000009 ;// EMC_RW2PDEN_0
D.S SD:0x7000F490  %LE %LONG  0x000000C8 ;// EMC_TXSR_0
D.S SD:0x7000F494  %LE %LONG  0x00000003 ;// EMC_TCKE_0
D.S SD:0x7000F498  %LE %LONG  0x00000007 ;// EMC_TFAW_0
D.S SD:0x7000F49C  %LE %LONG  0x00000003 ;// EMC_TRPAB_0
D.S SD:0x7000F4A0  %LE %LONG  0x00000006 ;// EMC_TCLKSTABLE_0
D.S SD:0x7000F4A4  %LE %LONG  0x00000002 ;// EMC_TCLKSTOP_0
D.S SD:0x7000F4A8  %LE %LONG  0x00000000 ;// EMC_TREFBW_0
D.S SD:0x7000F4B0  %LE %LONG  0x00000000 ;// EMC_ODT_WRITE_0
D.S SD:0x7000F4B4  %LE %LONG  0x00000000 ;// EMC_ODT_READ_0
D.S SD:0x7000F4AC  %LE %LONG  0x00000000 ;// EMC_QUSE_EXTRA_0
D.S SD:0x7000F514  %LE %LONG  0x00000002 ;// EMC_FBIO_CFG6_0
D.S SD:0x7000F4F4  %LE %LONG  0x00000000 ;// EMC_FBIO_CFG1_0
D.S SD:0x7000F6BC  %LE %LONG  0x00500004 ;// EMC_CFG_DIG_DLL_0
D.S SD:0x7000F4F8  %LE %LONG  0x2F2F2F2F ;// EMC_FBIO_DQSIB_DLY_0
D.S SD:0x7000F4FC  %LE %LONG  0x00000000 ;// EMC_FBIO_DQSIB_DLY_MSB_0
D.S SD:0x7000F50C  %LE %LONG  0x2F2F2F2F ;// EMC_FBIO_QUSE_DLY_0
D.S SD:0x7000F510  %LE %LONG  0x00000000 ;// EMC_FBIO_QUSE_DLY_MSB_0
D.S SD:0x7000F500  %LE %LONG  0x00000000 ;// EMC_FBIO_SPARE_0
D.S SD:0x7000F6C0  %LE %LONG  0x00000010 ;// EMC_DLL_XFORM_DQS_0
D.S SD:0x7000F6C4  %LE %LONG  0x00000008 ;// EMC_DLL_XFORM_QUSE_0
D.S SD:0x7000F428  %LE %LONG  0x00000001 ;// EMC_TIMING_CONTROL_0
D.S SD:0x7000F424  %LE %LONG  0x00000001 ;// EMC_PIN_0
D.S SD:0x7000F4DC  %LE %LONG  0x00000001 ;// EMC_NOP_0
D.S SD:0x7000F4D8  %LE %LONG  0x00000001 ;// EMC_PRE_0
D.S SD:0x7000F4D0  %LE %LONG  0x00200000 ;// EMC_EMRS_0
D.S SD:0x7000F4D0  %LE %LONG  0x00300000 ;// EMC_EMRS_0
D.S SD:0x7000F4D0  %LE %LONG  0x00100000 ;// EMC_EMRS_0
D.S SD:0x7000F4CC  %LE %LONG  0x00000100 ;// EMC_MRS_0
D.S SD:0x7000F4D8  %LE %LONG  0x00000001 ;// EMC_PRE_0
D.S SD:0x7000F4D4  %LE %LONG  0x00000001 ;// EMC_REF_0
D.S SD:0x7000F4D4  %LE %LONG  0x00000001 ;// EMC_REF_0
D.S SD:0x7000F4CC  %LE %LONG  0x00000A5A ;// EMC_MRS_0
D.S SD:0x7000F4D0  %LE %LONG  0x00100380 ;// EMC_EMRS_0
D.S SD:0x7000F4D0  %LE %LONG  0x00100000 ;// EMC_EMRS_0
D.S SD:0x7000F428  %LE %LONG  0x00000001 ;// EMC_TIMING_CONTROL_0
D.S SD:0x7000F420  %LE %LONG  0x80000000 ;// EMC_REFCTRL_0
D.S SD:0x7000F40C  %LE %LONG  0x0301FF00 ;// EMC_CFG_0
D.S SD:0x7000F00C  %LE %LONG  0x00080000 ;// MC_EMEM_CFG_0
D.S SD:0x7000F10C  %LE %LONG  0x80000003 ;// MC_LOWLATENCY_CONFIG_0
D.S SD:0x6000C0E0  %LE %LONG  0x00010000 ;// AHB_ARBITRATION_XBAR_CTRL_0

; Don't know if these are really required
D.S SD:0x700000A0  %LE %LONG  0x00000000 ;// APB_MISC_PP_PULLUPDOWN_REG_A_0
D.S SD:0x700000A4  %LE %LONG  0x00000000 ;// APB_MISC_PP_PULLUPDOWN_REG_B_0
D.S SD:0x700000A8  %LE %LONG  0x00000000 ;// APB_MISC_PP_PULLUPDOWN_REG_C_0
D.S SD:0x700000AC  %LE %LONG  0x00000000 ;// APB_MISC_PP_PULLUPDOWN_REG_D_0


D.S SD:0x70000024  %LE %LONG  0x000000C0 ;// APB_MISC_PP_CONFIG_CTL_0
D.S SD:0x7000E434  %LE %LONG  0x00000007 ;// APBDEV_PMC_REMOVE_CLAMPING_CMD_0

enddo

